#include <Wire.h>
#include <RTClib.h>
#include <PCA9685.h>
#include <avr/pgmspace.h>
#include <EEPROMex.h>
#include <Timer.h>
#include <OneWire.h>
#include <MemoryFree.h>
#include <LiquidCrystal_I2C.h>
#include <SoftwareSerial.h>
#include <Keypad_I2C.h>
//#include <Keypad.h>
#include "structs.h"
#include "config.h"

Timer t;
PCA9685 ledDriver; 
RTC_DS1307 rtc;
OneWire  ds(PIN_TEMP);
SoftwareSerial PHserial(rx, tx);
LiquidCrystal_I2C lcd(0x20);  // Set the LCD I2C address
uint8_t stringStart, stringStop = 0;
uint8_t scrollCursor = 16;
String lightPercent= "";


boolean manualLight=false;
boolean manualRelay=false;
boolean pumpReset=false;
boolean feederReset=false;


PROGMEM prog_uint16_t pwmtable[] = {0,0,0,0,0,0,0,0,0,0,0,0,0,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3,
          3,3,3,3,3,3,3,3,3,4,4,4,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13,
          13,13,14,14,14,14,14,15,15,15,15,15,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27,
          27,27,28,28,28,28,29,29,29,30,30,30,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46,
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          3979,3984,3988,3992,3997,4001,4005,4010,4014,4018,4023,4027,4031,4036,4040,4045,4049,4053,4058,4062,4066,4071,4075,4080,4084,4088,4093};


const byte ROWS = 4; //four rows
const byte COLS = 4; //three columns
//define the cymbols on the buttons of the keypads
char keys[ROWS][COLS] = {
  {'1','2','3','A'},
  {'4','5','6','B'},
  {'7','8','9','C'},
  {'*','0','#','D'}
};
byte rowPins[ROWS] = {0, 1, 2, 3}; //connect to the row pinouts of the keypad
byte colPins[COLS] = {4, 5, 6, 7}; //connect to the column pinouts of the keypad

//initialize an instance of class NewKeypad
Keypad_I2C keypad = Keypad_I2C( makeKeymap(keys), rowPins, colPins, ROWS, COLS, KEYPADI2C );

//WasserTemperatur
float temperatur;

unsigned long last_print = 0;
uint8_t switch_print=0;

String inputString = "";         // a string to hold incoming data
boolean stringComplete = false;  // whether the string is complete

// ph
char ph_data[20];
char computerdata[20];
byte received_from_computer=0;
byte received_from_sensor=0;
byte arduino_only=0;
byte startup=0;
float ph=0;
byte string_received=0;
const int maxAllowedWrites = 1000;
const int memBase          = 10;
int eepromLight= memBase;
int eepromDosing= eepromLight+(sizeof(s_lightVal)*8);
int eepromTemp= eepromDosing+(sizeof(s_dosingVal)*PUMPCOUNTS);
int eepromPH= eepromTemp+(sizeof(coolingTemp));
int eepromRelay= eepromPH+(sizeof(phValue));
int eepromFeeding= eepromRelay+(sizeof(relay_channels));
uint8_t eepromAdrLight= 0;
uint8_t eepromAdrDosing= 1;
uint8_t eepromAdrTemp= 2;
uint8_t eepromAdrPH= 3;
uint8_t eepromAdrRelay= 4;
uint8_t eepromAdrFeeding= 5;

          
void setup() {

  // start reading from position memBase (address 0) of the EEPROM. Set maximumSize to EEPROMSizeUno 
  // Writes before membase or beyond EEPROMSizeUno will only give errors when _EEPROMEX_DEBUG is set
  EEPROM.setMemPool(memBase, EEPROMSizeUno);
  // Set maximum allowed writes to maxAllowedWrites. 
  // More writes will only give errors when _EEPROMEX_DEBUG is set
  EEPROM.setMaxAllowedWrites(maxAllowedWrites);
  
  if(EEPROM.readByte(eepromAdrTemp)==overwrite){
    coolingTemp=EEPROM.readInt(eepromTemp);
  }else{
    EEPROM.updateInt(eepromTemp, coolingTemp);
    EEPROM.updateByte(eepromAdrTemp, overwrite);
  }
  if(EEPROM.readByte(eepromAdrPH)==overwrite){
    phValue=EEPROM.readDouble(eepromPH);
  }else{
    EEPROM.updateDouble(eepromPH, phValue);
    EEPROM.updateByte(eepromAdrPH, overwrite);
  }
  
  setLightSettings();
  setPumpSettings();
  // reserve 200 bytes for the inputString:
  inputString.reserve(200);
  PHserial.begin(38400);
  
  
  Serial.begin(9600);    // Ausgabe am PC
  
  pinMode( PIN_PWM,OUTPUT);  // PWM PIN    // Lüfter
  
  for (int i=0;i<=PUMPCOUNTS;i++){
    pinMode(dosing[i].pinAddr, OUTPUT);
  }
  
  digitalWrite(PIN_PWM, LOW);
  
  Wire.begin();           // Wire must be started!
  rtc.begin();
  keypad.begin( );    

  
  ledDriver.begin(B000000);  // Address pins A5-A0 set to B111000
  ledDriver.init();
  lcd.begin(16,2);               // initialize the lcd 
  byte Celsius[8] = {B11100,B10100,B11100,B0000,B00000,B00000,B00000,B00000};
  lcd.createChar(0, Celsius);
  keypad.addEventListener(keypadEvent); // Add an event listener for this keypad
}

void loop() {
  // print the string when a newline arrives:
  if (stringComplete) {
    serialHandler(inputString);
    // clear the string:
    inputString = "";
    stringComplete = false;
  }
  rtc.now();
  t.update();
  setDosing(0);
  
  setFeeding();
  
  if(use_relay && manualRelay==false){
    setRelay();
  }
  if(PHserial.available() > 0 && show_ph==true){
   received_from_sensor=PHserial.readBytesUntil(13,ph_data,20);
   ph_data[received_from_sensor]=0;
   string_received=1;
  } 
  if(arduino_only==1 && show_ph==true){
    Arduino_Control();
  }
  
  if (millis() - last_print > 1000) {
    last_print = millis();
    switch_print++;
    
    // Display ausgabe Obere Zeile
    lcd.setCursor ( 0, 0 ); 
    lcd.print (retTime());
    if (switch_print <= 5){
      switch_print = millis();
      lcd.setCursor ( 9, 0 ); 
      lcd.print (F("C="));
      lcd.print (getTemp());
      lcd.write ((uint8_t)0);
    }else if (switch_print < 10 && show_ph==true){
      lcd.setCursor ( 9, 0 ); 
      lcd.print (F("ph="));
      lcd.print (ph_data);
    }else{
      switch_print=0;
    }
    
    // Display ausgabe Untere Zeile
    lcd.setCursor(scrollCursor, 1);
    if(!manualLight){
      
      // Licht Dimmen / Sting bauen
      setLight();
      lcd.print(lightPercent.substring(stringStart,stringStop));
      if(stringStart == 0 && scrollCursor > 0){
        scrollCursor--;
        stringStop++;
      } else if (stringStart == stringStop){
        stringStart = stringStop = 0;
        scrollCursor = 16;
      } else if (stringStop == lightPercent.length() && scrollCursor == 0) {
        stringStart++;
      } else {
        stringStart++;
        stringStop++;
      }
    
    }else{
      lcd.print(F("Manueller Modus"));
    }
//    Serial.println(freeMemory());
    temperatur = getTemp();
    if(coolingTemp+2.0 < temperatur){
        analogWrite(PIN_PWM,255);
    }else if(coolingTemp-2.0 > temperatur){
        analogWrite(PIN_PWM,0);
    }
    if(atof(ph_data)+0.10 < phValue && digitalRead(RELAY1)==HIGH){
        digitalWrite(RELAY1,LOW);
    }else if(atof(ph_data)-0.10 > phValue && digitalRead(RELAY1)==LOW){
        digitalWrite(RELAY1,HIGH);
    }
  }            
}

float getTemp(){
  byte present = 0;
  //byte type_s = 0;
  byte data[12];
  byte addr[8];
  ds.search(addr);
      
  ds.reset();
  ds.select(addr);
  ds.write(0x44, 1);        // start conversion, with parasite power on at the end
  
  present = ds.reset();
  ds.select(addr);    
  ds.write(0xBE);         // Read Scratchpad

  for (byte i = 0; i < 9; i++) {           // we need 9 bytes
    data[i] = ds.read();
  }
  int16_t raw = (data[1] << 8) | data[0];
  
  //byte cfg = (data[4] & 0x60);
  return (float)raw / 16.0; //celsius;
}
